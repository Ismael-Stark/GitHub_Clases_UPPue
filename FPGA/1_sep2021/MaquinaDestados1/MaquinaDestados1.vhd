---------------------------------------------------
-- Generated by Boole-Deusto.
-- Timestamp: 2022-03-24 08:38:42
-- Computer name: MASTER-RACE
-- User name: Edicion
---------------------------------------------------


library IEEE;
use IEEE.STD_LOGIC_1164.ALL;
use IEEE.STD_LOGIC_ARITH.ALL;
use IEEE.STD_LOGIC_UNSIGNED.ALL;

entity secuencia is
	Port (
		inicio: in std_logic;
		ck: in std_logic;
		I0: in std_logic;
		O0: out std_logic
		);
end secuencia;

architecture MaquinaDestados1 of secuencia is

type nombres_estados is (S0, S1);
signal estado: nombres_estados;
signal entrada_aux: std_logic;

begin

entrada_aux<=I0;

process(inicio, ck)
begin
if inicio='1' then
	estado<=S0;
elsif ck='1' and ck'event then
	case estado is
		when S0 =>
			case entrada_aux is
				when '0' => estado<=S0;
				when '1' => estado<=S1;
				when others => estado<=S0;
			end case;
		when S1 =>
			case entrada_aux is
				when '0' => estado<=S0;
				when '1' => estado<=S1;
				when others => estado<=S0;
			end case;
		when others => estado<=S0;
	end case;
end if;
end process;

process(estado, entrada_aux)
begin
case estado is
	when S0 =>
		case entrada_aux is 			when '0' => O0<='0';			when '1' => O0<='0';
			when others => O0<='0';
		end case;
	when S1 =>
		case entrada_aux is
			when '0' => O0<='1';
			when '1' => O0<='0';
			when others => O0<='0';
		end case;
end case;
end process;

end MaquinaDestados1;
